## config/boards/shields/slabKB/Kconfig.defconfig
```kconfig
if SHIELD_slabKBL

config ZMK_KEYBOARD_NAME
    default "slabKB"

config ZMK_SPLIT_ROLE_CENTRAL
    default y

endif

if SHIELD_slabKBL || SHIELD_slabKBR

config ZMK_SPLIT
    default y

endif
```

## config/boards/shields/slabKB/Kconfig.shield
```kconfig
config SHIELD_slabKBL
    def_bool $(shields_list_contains, slabKBL)

config SHIELD_slabKBR
    def_bool $(shields_list_contains, slabKBR)

config SHIELD_slabKBD
    def_bool $(shields_list_contains, slabKBD)
```
